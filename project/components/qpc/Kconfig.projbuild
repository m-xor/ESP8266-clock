## project/components/qpc/Kconfig.projbuild
```kconfig
menu "QPC config"
#config USING_QS
#	   bool "Use QSpy"
#	   default "n"
#	   help
#	      Enable QSpy monitoring tool.
#	
#	      In order to make it work, you need to configure UART output.

config QPC_TASK_STACK_SIZE
    int "QPC state machine Task stack size"
    range 1024 32768
    default 2048
    help
        FreeRTOS minimal stack size causes stack overflow
	
endmenu
```

## project/main/Kconfig.projbuild
```kconfig
menu "NTP Clock Project Configuration"

menu "Pin Assigning"
config PRJ_BUTTON
    int "Btn pin nr"
    default 4
    help
	Number of pin assigning to button activating AP+Httpd.
endmenu


config ESP_WIFI_SSID
    string "WiFi SSID"
    default "ClockConfig"
    help
	SSID for soft AP to connect.

config ESP_WIFI_PASSWORD
    string "WiFi Password"
    default "esp clock config page"
    help
	WiFi password for soft AP.
		
config MAX_STA_CONN
    int "Max STA conn"
    default 2
    help
	Max number of the STA connects to soft AP.

config AP_CONN_TIMEOUT
    int "Httpd connection timeout in seconds"
    default 60
    help
	Time httpd and AP would be deactivated since last transmission.
endmenu
```
